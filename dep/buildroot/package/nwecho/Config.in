## dep/buildroot/package/nwecho/Config.in
```kconfig
config BR2_PACKAGE_NWECHO
    bool "nwecho"
    help
      The NW echo benchmark module.
```

## dep/buildroot/package/nwlatency/Config.in
```kconfig
config BR2_PACKAGE_NWLATENCY
    bool "nwlatency"
    help
      The NW latency benchmark module.
```

## dep/buildroot/package/nwreceiver/Config.in
```kconfig
config BR2_PACKAGE_NWRECEIVER
    bool "nwreceiver"
    help
      The NW receiver benchmark module.
```

## dep/buildroot/package/nwsender/Config.in
```kconfig
config BR2_PACKAGE_NWSENDER
    bool "nwsender"
    help
      The NW sender benchmark module.
```

## dep/buildroot/package/txctl/Config.in
```kconfig
config BR2_PACKAGE_TXCTL
    bool "txctl"
    help
      The TX benchmark control module.
```
